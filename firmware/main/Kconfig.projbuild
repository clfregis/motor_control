## firmware/main/Kconfig.projbuild
```kconfig
menu "Motor Configuration"

	config motorValue
		string "Motor value"
		default "motor_1"
		help
			Defines which motor this ESP32 will be attached on.

	config firebaseAddress
		string "Firebase Address"
		default "esp32-66ba5.firebaseio.com"
		help
			Do not inclued 'http://' only 'address.firebaseio.com'.

	config SPTimesec
		int "SP Time in seconds"
		default "50"
		help
			This is the maximum allowed continuous operation time of the motor, in seconds.

	choice
		prompt "Time Zone"
		default Mexico
		help
			Choose the Time Zone.
		config Mexico
			bool "Mexico"
		config Brazil
			bool "Brazil"
	endchoice

	config debug
		bool "Log prints for Debug"
		help
			Show the log of operation for debug.

endmenu


menu "WiFi Configuration"

	config wifissid
		string "WiFi SSID"
		default "MY_SSID"
		help
			WiFi's SSID connection.

	config wifipass
		string "WiFi Password"
		default "MY_Password"
		help
			WiFi's Password.
endmenu
```

## main/Kconfig.projbuild
```kconfig
menu "Motor Configuration"

	config motorValue
		string "Motor value"
		default "motor_1"
		help
			Defines which motor this ESP32 will be attached on.

	config firebaseAddress
		string "Firebase Address"
		default "esp32-66ba5.firebaseio.com"
		help
			Do not inclued 'http://' only 'address.firebaseio.com'.

	config SPTimesec
		int "SP Time in seconds"
		default "50"
		help
			This is the maximum allowed continuous operation time of the motor, in seconds.

	choice
		prompt "Time Zone"
		default Mexico
		help
			Choose the Time Zone.
		config Mexico
			bool "Mexico"
		config Brazil
			bool "Brazil"
	endchoice

	config debug
		bool "Log prints for Debug"
		help
			Show the log of operation for debug.

endmenu
```
